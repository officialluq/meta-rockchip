## conf/machine/include/rk3588.inc
```bitbake
# Copyright (c) 2021, Rockchip Electronics Co., Ltd
# Released under the MIT license (see COPYING.MIT for the terms)

require conf/machine/include/rockchip-arm64-common.inc

SOC_FAMILY := "rk3588"

PREFERRED_VERSION_linux-rockchip := "5.10%"

KBUILD_DEFCONFIG := "rockchip_linux_defconfig"

MALI_GPU := "valhall-g610"
MALI_VERSION := "g6p0"

RK_ISP_VERSION := "3.0"
PREFERRED_PROVIDER_trusted-firmware-a = "rockchip-rkbin"
PREFERRED_PROVIDER_optee-os = "rockchip-rkbin"

UBOOT_SUFFIX ?= "itb"
UBOOT_ENTRYPOINT ?= "0x06000000"
```

## conf/machine/orangepi5-rk3588s.conf
```bitbake
# Copyright (c) 2021, Rockchip Electronics Co., Ltd
# Released under the MIT license (see COPYING.MIT for the terms)

#@TYPE: Machine
#@NAME: RK3588 EVB

require conf/machine/include/rk3588.inc
KERNEL_DEVICETREE = "rockchip/rk3588s-orangepi-5b.dtb"
WKS_FILE = "rockchip.wks"
PREFERRED_PROVIDER_virtual/bootloader = "u-boot"
UBOOT_MACHINE = "orangepi-5-rk3588s_defconfig"
MACHINE_EXTRA_RRECOMMENDS = " kernel-modules kernel-devicetree"
PREFERRED_PROVIDER_virtual/kernel = "linux-rockchip"

RK_WIFIBT_FIRMWARES = " \
	rkwifibt-firmware-ap6275p-wifi \
	rkwifibt-firmware-ap6275-bt \
	brcm-tools \
"
```

## wic/rockchip.wks
```
# Copyright (C) 2019,2020 Garmin Ltd. or its subsidiaries
# Copyright (C) 2021 Trevor Woerner
# Released under the MIT license (see COPYING.MIT for the terms)
#
# short-description: Create a disk image suitable for booting Rockchip from SD-card
# long-description: Creates a disk image partitioned using GPT, suitable for Rockchip
# Disk layout
# Note that the reference documentation refers to 512 byte disk sectors, but
# wic uses 1KB blocks. The following table uses 512 byte sectors:
#
#   Partition   Start Sector    Number of Sectors
#   loader1     64              8000        (idbloader / U-Boot SPL)
#   reserved1   8064            128
#   reserved2   8192            8192
#   loader2     16384           8192        (U-Boot proper)
#   atf         24576           8192
#   boot        32768           229376
#   root        262144          -           (suggested)
bootloader --ptable msdos
part loader1    --offset 32     --fixed-size 4000K --source rawcopy   --sourceparams="file=idbloader.img"
part loader2    --offset 8192   --fixed-size 4096K   --source rawcopy --sourceparams="file=u-boot.itb"
part /    --source rootfs  --fstype=ext4 --label root --use-uuid
```
